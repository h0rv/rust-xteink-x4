## crates/xteink-firmware/sdkconfig.defaults
```kconfig
# Keep main task stack high enough for EPUB open + render on ESP32-C3.
# Values that are too low cause stack protection faults in EPUB tasks.
CONFIG_ESP_MAIN_TASK_STACK_SIZE=114688

# Temporary diagnostic: disable watchdogs to unblock startup reset loop
# while we isolate the long blocking path in display init/update.
CONFIG_ESP_TASK_WDT_EN=n
CONFIG_ESP_INT_WDT=n

# Use this to set FreeRTOS kernel tick frequency to 1000 Hz (100 Hz by default).
# This allows to use 1 ms granularity for thread sleeps (10 ms by default).
#CONFIG_FREERTOS_HZ=1000

# Workaround for https://github.com/espressif/esp-idf/issues/7631
#CONFIG_MBEDTLS_CERTIFICATE_BUNDLE=n
#CONFIG_MBEDTLS_CERTIFICATE_BUNDLE_DEFAULT_FULL=n

# FATFS long filename support
CONFIG_FATFS_LONG_FILENAMES=y
CONFIG_FATFS_LFN_HEAP=y
CONFIG_FATFS_MAX_LFN=255
CONFIG_FATFS_API_ENCODING_UTF_8=y
CONFIG_FATFS_SECTOR_512=y
CONFIG_FATFS_SECTOR_4096=n
CONFIG_FATFS_VOLUME_COUNT=1
# Keep FATFS RAM usage low on ESP32-C3.
CONFIG_FATFS_PER_FILE_CACHE=n

# Use custom partition table from this crate.
CONFIG_PARTITION_TABLE_CUSTOM=y
CONFIG_PARTITION_TABLE_CUSTOM_FILENAME="$ENV{PROJECT_DIR}/crates/xteink-firmware/partitions.csv"

# Flash size
CONFIG_ESPTOOLPY_FLASHSIZE_16MB=y
```
